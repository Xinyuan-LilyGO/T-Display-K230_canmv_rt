## canmv_k230/src/rtsmart/rtsmart/kernel/bsp/maix3/components/Kconfig
```kconfig
menu "Components Configuration"

    menuconfig ENABLE_CHERRY_USB
        bool "Enable CherryUSB"

        if ENABLE_CHERRY_USB
            config CHERRYUSB_DEVICE_DWC2_K230
                def_bool y

            config CHERRYUSB_HOST_DWC2_K230
                def_bool y

            config CHERRY_USB_OSAL_RTTHREAD
                def_bool y

            menuconfig ENABLE_CHERRY_USB_DEVICE
                bool "Enable CherryUSB Device"
                default n

                if ENABLE_CHERRY_USB_DEVICE
                    choice CHERRY_USB_DEVICE_USING_DEV
                        bool "CherryUSB Device Use Device"
                        default CHERRY_USB_DEVICE_USING_DEV0

                        config CHERRY_USB_DEVICE_USING_DEV0
                            bool "Using Dev0"

                        config CHERRY_USB_DEVICE_USING_DEV1
                            bool "Using Dev1"
                    endchoice

                    config CHERRY_USB_DEVICE_USING_DEV
                        int
                        default 0 if CHERRY_USB_DEVICE_USING_DEV0
                        default 1 if CHERRY_USB_DEVICE_USING_DEV1

                    config CHERRY_USB_DEVICE_SPEED_HS
                        def_bool y

                    config CHERRY_USB_DEVICE_ENABLE_CLASS_CDC_ACM
                        bool "Enable CDC ACM"

                    config CHERRY_USB_DEVICE_ENABLE_CLASS_MSC
                        bool "Enable MSC"

                    config CHERRY_USB_DEVICE_ENABLE_CLASS_MTP
                        bool "Enable MTP"
                        select CHERRY_USB_DEVICE_ENABLE_CLASS_MSC
                endif

            config ENABLE_CANMV_USB_DEV
                bool "Enable USB Device for CanMV"
                default y
                select CHERRY_USB_DEVICE_ENABLE_CLASS_CDC_ACM
                select CHERRY_USB_DEVICE_ENABLE_CLASS_MTP
                help
                    CanMV USB Device Select class CDC_ACM and MSC MTP

            menuconfig ENABLE_CHERRY_USB_HOST
                bool "Enable CherryUSB Host"
                default n

                if ENABLE_CHERRY_USB_HOST

                    choice CHERRY_USB_HOST_USING_DEV
                        bool "CherryUSB Host Use Device"
                        default CHERRY_USB_HOST_USING_DEV0

                        config CHERRY_USB_HOST_USING_DEV0
                            bool "Using Dev0"

                        config CHERRY_USB_HOST_USING_DEV1
                            bool "Using Dev1"
                    endchoice

                    config CHERRY_USB_HOST_USING_DEV
                        int
                        default 0 if CHERRY_USB_HOST_USING_DEV0
                        default 1 if CHERRY_USB_HOST_USING_DEV1

                    config CHERRY_USB_HOST_ENABLE_CLASS_HID
                        bool "Enable HID"
                        default n

                    config CHERRY_USB_HOST_ENABLE_CLASS_NET_RTL8152
                        bool "Enable net RTL8152"
                        default y

                    config CHERRY_USB_HOST_ENABLE_CLASS_CDC_ACM
                        bool "Enable cdc ACM"
                        default n

                    config CHERRY_USB_HOST_ENABLE_CLASS_CDC_ECM
                        bool "Enable cdc ECM"
                        default n

                endif

            config ENABLE_CANMV_USB_HOST
                bool "Enable USB Host for CanMV"
                default n
                select CHERRY_USB_HOST_ENABLE_CLASS_NET_RTL8152
                help
                    CanMV USB Host Select class net/rtl8152

            if ENABLE_CANMV_USB_HOST
                config CANMV_USB_PWR_PIN
                    int "CanMV USB Host Power Control GPIO"
                    default -1
                config CANMV_USB_PWR_PIN_VALID_VAL
                    int "CanMV USB Host Power Vaild PIN Value"
                    default 1
            endif

            config CANMV_USB_HOST_NET_RTL8152_DEV_NAME
                string
                default "u0"
        endif

    config RT_USING_DEVMEM2
        bool "Enable devmem2"
        def_bool y

    config RT_USING_USAGE
        bool "Enable CPU usage"
        def_bool y

    config ENABLE_CANMV_NETWORK_MGMT_DEV
        bool "Enable NetWork Mgmt for CanMV"
        default n

    config ENABLE_CANMV_MISC_DEV
        bool "Enable misc Device for CanMV"
        default y

    source "components/netutils/Kconfig"

endmenu
```

## canmv_k230/src/rtsmart/rtsmart/kernel/bsp/maix3/configs/k230_canmv_dongshanpi_defconfig
```kconfig
CONFIG_RT_NAME_MAX=20
CONFIG_RT_USING_SMART=y
CONFIG_RT_ALIGN_SIZE=8
CONFIG_RT_THREAD_PRIORITY_32=y
CONFIG_RT_THREAD_PRIORITY_MAX=32
CONFIG_RT_TICK_PER_SECOND=1000
CONFIG_RT_USING_OVERFLOW_CHECK=y
CONFIG_RT_USING_HOOK=y
CONFIG_RT_USING_IDLE_HOOK=y
CONFIG_RT_IDLE_HOOK_LIST_SIZE=4
CONFIG_IDLE_THREAD_STACK_SIZE=16384
CONFIG_RT_USING_TIMER_SOFT=y
CONFIG_RT_TIMER_THREAD_PRIO=4
CONFIG_RT_TIMER_THREAD_STACK_SIZE=16384
CONFIG_RT_DEBUG=y
CONFIG_RT_USING_SEMAPHORE=y
CONFIG_RT_USING_MUTEX=y
CONFIG_RT_USING_EVENT=y
CONFIG_RT_USING_MAILBOX=y
CONFIG_RT_USING_MESSAGEQUEUE=y
CONFIG_RT_USING_SIGNALS=y
CONFIG_RT_USING_MEMPOOL=y
CONFIG_RT_USING_MEMHEAP=y
CONFIG_RT_USING_MEMHEAP_AS_HEAP=y
CONFIG_RT_USING_HEAP=y
CONFIG_RT_USING_DEVICE=y
CONFIG_RT_USING_DEVICE_OPS=y
CONFIG_RT_USING_CONSOLE=y
CONFIG_RT_CONSOLEBUF_SIZE=256
CONFIG_RT_CONSOLE_DEVICE_NAME="uart"
CONFIG_RT_VER_NUM=0x50000
CONFIG_ARCH_CPU_64BIT=y
CONFIG_RT_USING_CACHE=y
CONFIG_ARCH_MM_MMU=y
CONFIG_RT_USING_USERSPACE=y
CONFIG_KERNEL_VADDR_START=0x150000000
CONFIG_PV_OFFSET=0
CONFIG_ARCH_RISCV=y
CONFIG_ARCH_RISCV64=y
CONFIG_RT_USING_COMPONENTS_INIT=y
CONFIG_RT_USING_USER_MAIN=y
CONFIG_RT_MAIN_THREAD_STACK_SIZE=16384
CONFIG_RT_MAIN_THREAD_PRIORITY=10
CONFIG_RT_USING_MSH=y
CONFIG_RT_USING_FINSH=y
CONFIG_FINSH_USING_MSH=y
CONFIG_FINSH_THREAD_NAME="tshell"
CONFIG_FINSH_THREAD_PRIORITY=20
CONFIG_FINSH_THREAD_STACK_SIZE=81920
CONFIG_FINSH_USING_HISTORY=y
CONFIG_FINSH_HISTORY_LINES=5
CONFIG_FINSH_USING_SYMTAB=y
CONFIG_FINSH_CMD_SIZE=1024
CONFIG_MSH_USING_BUILT_IN_COMMANDS=y
CONFIG_FINSH_USING_DESCRIPTION=y
CONFIG_FINSH_ARG_MAX=100
CONFIG_MSH_WAIT_LWP_FINISH=y
CONFIG_RT_USING_DFS=y
CONFIG_DFS_USING_WORKDIR=y
CONFIG_DFS_FILESYSTEMS_MAX=8
CONFIG_DFS_FILESYSTEM_TYPES_MAX=6
CONFIG_DFS_FD_MAX=64
CONFIG_RT_USING_DFS_ELMFAT=y
CONFIG_RT_DFS_ELM_CODE_PAGE=437
CONFIG_RT_DFS_ELM_WORD_ACCESS=y
CONFIG_RT_DFS_ELM_USE_LFN_3=y
CONFIG_RT_DFS_ELM_USE_LFN=3
CONFIG_RT_DFS_ELM_MAX_LFN=255
CONFIG_RT_DFS_ELM_DRIVES=3
CONFIG_RT_DFS_ELM_MAX_SECTOR_SIZE=512
CONFIG_RT_DFS_ELM_REENTRANT=y
CONFIG_RT_USING_DFS_DEVFS=y
CONFIG_RT_USING_DFS_ROMFS=y
CONFIG_RT_USING_DFS_TMPFS=y
CONFIG_RT_USING_PROC=y
CONFIG_RT_USING_DFS_PROCFS=y
CONFIG_RT_USING_DEVICE_IPC=y
CONFIG_RT_UNAMED_PIPE_NUMBER=64
CONFIG_RT_PIPE_BUFSZ=512
CONFIG_RT_USING_SYSTEM_WORKQUEUE=y
CONFIG_RT_SYSTEM_WORKQUEUE_STACKSIZE=20480
CONFIG_RT_SYSTEM_WORKQUEUE_PRIORITY=23
CONFIG_RT_USING_SERIAL=y
CONFIG_RT_USING_SERIAL_V1=y
CONFIG_RT_SERIAL_USING_DMA=y
CONFIG_RT_SERIAL_RB_BUFSZ=64
CONFIG_RT_USING_TTY=y
CONFIG_RT_USING_HWTIMER=y
CONFIG_RT_USING_CPUTIME=y
CONFIG_RT_USING_CPUTIME_RISCV=y
CONFIG_RT_USING_I2C=y
CONFIG_RT_USING_I2C_BITOPS=y
CONFIG_RT_USING_PIN=y
CONFIG_RT_USING_ADC=y
CONFIG_RT_USING_NULL=y
CONFIG_RT_USING_ZERO=y
CONFIG_RT_USING_RANDOM=y
CONFIG_RT_USING_DEVMEM=y
CONFIG_RT_USING_PWM=y
CONFIG_RT_USING_PM=y
CONFIG_RT_USING_RTC=y
CONFIG_RT_USING_HARDLOCK=y
CONFIG_RT_USING_SDIO=y
CONFIG_RT_SDIO_STACK_SIZE=10240
CONFIG_RT_SDIO_THREAD_PRIORITY=4
CONFIG_RT_MMCSD_STACK_SIZE=32768
CONFIG_RT_MMCSD_THREAD_PRIORITY=22
CONFIG_RT_MMCSD_MAX_PARTITION=16
CONFIG_RT_USING_SPI=y
CONFIG_RT_USING_WDT=y
CONFIG_RT_USING_TOUCH=y
CONFIG_RT_USING_DEV_BUS=y
CONFIG_RT_USING_WIFI=y
CONFIG_RT_WLAN_DEVICE_STA_NAME="sta"
CONFIG_RT_WLAN_DEVICE_AP_NAME="ap"
CONFIG_RT_WLAN_SSID_MAX_LENGTH=32
CONFIG_RT_WLAN_PASSWORD_MAX_LENGTH=32
CONFIG_RT_WLAN_DEV_EVENT_NUM=2
CONFIG_RT_WLAN_MANAGE_ENABLE=y
CONFIG_RT_WLAN_SCAN_WAIT_MS=10000
CONFIG_RT_WLAN_CONNECT_WAIT_MS=10000
CONFIG_RT_WLAN_SCAN_SORT=y
CONFIG_RT_WLAN_MSH_CMD_ENABLE=y
CONFIG_RT_WLAN_AUTO_CONNECT_ENABLE=y
CONFIG_AUTO_CONNECTION_PERIOD_MS=2000
CONFIG_RT_WLAN_CFG_ENABLE=y
CONFIG_RT_WLAN_CFG_INFO_MAX=3
CONFIG_RT_WLAN_PROT_ENABLE=y
CONFIG_RT_WLAN_PROT_NAME_LEN=8
CONFIG_RT_WLAN_PROT_MAX=2
CONFIG_RT_WLAN_DEFAULT_PROT="lwip"
CONFIG_RT_WLAN_PROT_LWIP_ENABLE=y
CONFIG_RT_WLAN_PROT_LWIP_NAME="lwip"
CONFIG_RT_WLAN_WORK_THREAD_ENABLE=y
CONFIG_RT_WLAN_WORKQUEUE_THREAD_NAME="wlan"
CONFIG_RT_WLAN_WORKQUEUE_THREAD_SIZE=4096
CONFIG_RT_WLAN_WORKQUEUE_THREAD_PRIO=15
CONFIG_RT_USING_LIBC=y
CONFIG_RT_USING_MUSL=y
CONFIG_RT_USING_POSIX=y
CONFIG_RT_USING_POSIX_CLOCKTIME=y
CONFIG_RT_USING_SAL=y
CONFIG_SAL_USING_LWIP=y
CONFIG_SAL_USING_POSIX=y
CONFIG_SAL_USING_AF_UNIX=y
CONFIG_RT_USING_NETDEV=y
CONFIG_NETDEV_USING_IFCONFIG=y
CONFIG_NETDEV_USING_PING=y
CONFIG_NETDEV_USING_NETSTAT=y
CONFIG_NETDEV_USING_AUTO_DEFAULT=y
CONFIG_NETDEV_IPV4=1
CONFIG_NETDEV_IPV6=0
CONFIG_RT_USING_LWIP=y
CONFIG_RT_USING_LWIP212=y
CONFIG_RT_LWIP_MEM_ALIGNMENT=8
CONFIG_RT_LWIP_IGMP=y
CONFIG_RT_LWIP_ICMP=y
CONFIG_RT_LWIP_DNS=y
CONFIG_RT_LWIP_DHCP=y
CONFIG_IP_SOF_BROADCAST=1
CONFIG_IP_SOF_BROADCAST_RECV=1
CONFIG_RT_LWIP_IPADDR="192.168.1.30"
CONFIG_RT_LWIP_GWADDR="192.168.1.1"
CONFIG_RT_LWIP_MSKADDR="255.255.255.0"
CONFIG_RT_LWIP_UDP=y
CONFIG_RT_LWIP_TCP=y
CONFIG_RT_LWIP_RAW=y
CONFIG_RT_MEMP_NUM_NETCONN=8
CONFIG_RT_MEMP_NUM_TCPIP_MSG_API=16
CONFIG_RT_MEMP_NUM_TCPIP_MSG_INPKT=16
CONFIG_RT_LWIP_PBUF_NUM=16
CONFIG_RT_LWIP_PBUF_STRUCT_NUM=16
CONFIG_RT_LWIP_NETBUF_NUM=16
CONFIG_RT_LWIP_RAW_PCB_NUM=8
CONFIG_RT_LWIP_UDP_PCB_NUM=8
CONFIG_RT_UDP_RECVMBOX_SIZE=16
CONFIG_RT_RECV_BUFSIZE_DEFAULT=64
CONFIG_RT_LWIP_TCP_PCB_NUM=8
CONFIG_RT_LWIP_TCP_SEG_NUM=40
CONFIG_RT_LWIP_TCP_SND_BUF=8196
CONFIG_RT_LWIP_TCP_WND=8196
CONFIG_RT_TCP_RECVMBOX_SIZE=16
CONFIG_RT_LWIP_TCPTHREAD_PRIORITY=10
CONFIG_RT_LWIP_TCPTHREAD_MBOX_SIZE=8
CONFIG_RT_LWIP_TCPTHREAD_STACKSIZE=10240
CONFIG_RT_LWIP_ETHTHREAD_PRIORITY=12
CONFIG_RT_LWIP_ETHTHREAD_STACKSIZE=10240
CONFIG_RT_LWIP_ETHTHREAD_MBOX_SIZE=8
CONFIG_LWIP_NETIF_STATUS_CALLBACK=1
CONFIG_LWIP_NETIF_LINK_CALLBACK=1
CONFIG_SO_REUSE=1
CONFIG_LWIP_SO_RCVTIMEO=1
CONFIG_LWIP_SO_SNDTIMEO=1
CONFIG_LWIP_SO_RCVBUF=1
CONFIG_LWIP_SO_LINGER=0
CONFIG_LWIP_NETIF_LOOPBACK=0
CONFIG_RT_LWIP_USING_PING=y
CONFIG_LWIP_USING_DHCPD=y
CONFIG_DHCPD_SERVER_IP="192.168.169.1"
CONFIG_DHCPD_USING_ROUTER=y
CONFIG_RT_USING_LWP=y
CONFIG_RT_LWP_MAX_NR=30
CONFIG_LWP_TASK_STACK_SIZE=16384
CONFIG_RT_CH_MSG_MAX_NR=1024
CONFIG_LWP_CONSOLE_INPUT_BUFFER_SIZE=1024
CONFIG_LWP_TID_MAX_NR=64
CONFIG_RT_LWP_SHM_MAX_NR=64
CONFIG_RT_USING_MPP=y
CONFIG_RT_FASTBOOT=y
CONFIG_RT_USING_GNNE=y
CONFIG_RT_USING_GPIO=y
CONFIG_RT_USING_I2C0=y
CONFIG_RT_USING_I2C1=y
CONFIG_RT_USING_I2C2=y
CONFIG_RT_USING_I2C3=y
CONFIG_RT_USING_I2C4=y
CONFIG_RT_USING_SPI0=y
CONFIG_RT_USING_SPI1=y
CONFIG_RT_USING_SPI2=y
CONFIG_RT_USING_RTC_PMU=y
CONFIG_RT_USING_SDIO1=y
CONFIG_SDCARD_ON_SDIO_DEV1=y
CONFIG_SDCARD_ON_SDIO_DEV=1
CONFIG_RT_USING_CANAAN_UART=y
CONFIG_RT_USING_UART_CANAAN_1=y
CONFIG_RT_USING_UART_CANAAN_2=y
CONFIG_RT_USING_UART_CANAAN_3=y
CONFIG_RT_USING_UART_CANAAN_4=y
CONFIG_CANAAN_UART_BUFFER_SIZE=131072
CONFIG_POLLIN_SIZE=CANAAN_UART_BUFFER_SIZE/2
CONFIG_UART_TIMEOUT=1000
CONFIG_RT_USING_REGULATOR=y
CONFIG_ENABLE_CHERRY_USB=y
CONFIG_CHERRYUSB_DEVICE_DWC2_K230=y
CONFIG_CHERRYUSB_HOST_DWC2_K230=y
CONFIG_CHERRY_USB_OSAL_RTTHREAD=y
CONFIG_ENABLE_CHERRY_USB_DEVICE=y
CONFIG_CHERRY_USB_DEVICE_USING_DEV0=y
CONFIG_CHERRY_USB_DEVICE_USING_DEV=0
CONFIG_CHERRY_USB_DEVICE_SPEED_HS=y
CONFIG_CHERRY_USB_DEVICE_ENABLE_CLASS_CDC_ACM=y
CONFIG_CHERRY_USB_DEVICE_ENABLE_CLASS_MSC=y
CONFIG_CHERRY_USB_DEVICE_ENABLE_CLASS_MTP=y
CONFIG_ENABLE_CANMV_USB_DEV=y
CONFIG_ENABLE_CHERRY_USB_HOST=y
CONFIG_CHERRY_USB_HOST_USING_DEV1=y
CONFIG_CHERRY_USB_HOST_USING_DEV=1
CONFIG_CHERRY_USB_HOST_ENABLE_CLASS_NET_RTL8152=y
CONFIG_ENABLE_CANMV_USB_HOST=y
CONFIG_CANMV_USB_PWR_PIN=-1
CONFIG_CANMV_USB_PWR_PIN_VALID_VAL=1
CONFIG_CANMV_USB_HOST_NET_RTL8152_DEV_NAME="u0"
CONFIG_RT_USING_DEVMEM2=y
CONFIG_RT_USING_USAGE=y
CONFIG_ENABLE_CANMV_NETWORK_MGMT_DEV=y
CONFIG_ENABLE_CANMV_MISC_DEV=y
CONFIG_PKG_USING_NETUTILS=y
CONFIG_PKG_NETUTILS_NTP=y
CONFIG_NTP_USING_AUTO_SYNC=y
CONFIG_NTP_AUTO_SYNC_FIRST_DELAY=30
CONFIG_NTP_AUTO_SYNC_PERIOD=3600
CONFIG_NETUTILS_NTP_HOSTNAME="cn.ntp.org.cn"
CONFIG_NETUTILS_NTP_HOSTNAME2="ntp.rt-thread.org"
CONFIG_NETUTILS_NTP_HOSTNAME3="edu.ntp.org.cn"
CONFIG_PKG_USING_NETUTILS_LATEST_VERSION=y
CONFIG_PKG_NETUTILS_VER_NUM=0x99999
CONFIG_CHIP_K230=y
CONFIG_ENABLE_FPU=y
CONFIG_ENABLE_VECTOR=y
CONFIG___STACKSIZE__=65536
CONFIG_RT_OPTIMIZE_LWP_LOAD=y
CONFIG_RT_VERSION_MAJOR=5
CONFIG_RT_VERSION_MINOR=9
CONFIG_RT_VERSION_PATCH=9
```

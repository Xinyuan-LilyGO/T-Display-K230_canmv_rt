## canmv_k230/src/uboot/uboot/configs/k230_burntool_defconfig
```kconfig
CONFIG_RISCV=y
CONFIG_SYS_TEXT_BASE=0x80360000
CONFIG_SYS_MALLOC_LEN=0x80000
CONFIG_NR_DRAM_BANKS=3
CONFIG_ENV_SIZE=0x10000
CONFIG_DEFAULT_DEVICE_TREE="k230_burntool"
CONFIG_SYS_PROMPT="K230# "
CONFIG_SYS_LOAD_ADDR=0x00000000
CONFIG_BUILD_TARGET="u-boot.bin"
CONFIG_TARGET_K230_BURNTOOL=y
CONFIG_ARCH_RV64I=y
CONFIG_SHOW_REGS=y
CONFIG_CC_OPTIMIZE_FOR_DEBUG=y
CONFIG_DISTRO_DEFAULTS=y
CONFIG_FIT=y
CONFIG_TIMESTAMP=y
CONFIG_FIT_SIGNATURE=y
CONFIG_LEGACY_IMAGE_FORMAT=y
CONFIG_BOOTDELAY=0
CONFIG_BOOTCOMMAND="kburn 0"
CONFIG_LOGLEVEL=7
CONFIG_SYS_STDIO_DEREGISTER=y
# CONFIG_SYS_DEVICE_NULLDEV is not set
CONFIG_DISPLAY_CPUINFO=y
CONFIG_DISPLAY_BOARDINFO=y
CONFIG_BOARD_EARLY_INIT_F=y
CONFIG_BOARD_LATE_INIT=y
CONFIG_CMD_GPT=y
CONFIG_CMD_MMC=y
CONFIG_CMD_MTD=y
# CONFIG_CMD_PINMUX is not set
CONFIG_CMD_SF_TEST=y
CONFIG_CMD_USB=y
CONFIG_CMD_KBURN=y
CONFIG_PARTITION_TYPE_GUID=y
CONFIG_OF_EMBED=y
CONFIG_SYS_RELOC_GD_ENV_ADDR=y
# CONFIG_NET is not set
# CONFIG_INPUT is not set
CONFIG_KBURN_MMC=y
CONFIG_MMC=y
CONFIG_MMC_HS200_SUPPORT=y
CONFIG_MMC_DW=y
CONFIG_MMC_SDHCI=y
CONFIG_MMC_SDHCI_SDMA=y
CONFIG_MMC_SDHCI_SNPS=y
CONFIG_DM_MTD=y
CONFIG_MTD_SPI_NAND=y
CONFIG_SPI_FLASH_SFDP_SUPPORT=y
CONFIG_SPI_FLASH_SOFT_RESET=y
CONFIG_SPI_FLASH_SOFT_RESET_ON_BOOT=y
CONFIG_SPI_FLASH_GIGADEVICE=y
CONFIG_SPI_FLASH_WINBOND=y
# CONFIG_SPI_FLASH_USE_4K_SECTORS is not set
CONFIG_SPI_FLASH_MTD=y
CONFIG_PINCTRL=y
CONFIG_PINCTRL_SINGLE=y
CONFIG_SYS_NS16550=y
CONFIG_SPI=y
CONFIG_DESIGNWARE_SPI=y
CONFIG_USB=y
CONFIG_DM_USB_GADGET=y
CONFIG_USB_DWC2=y
CONFIG_USB_HOST_ETHER=y
CONFIG_USB_ETHER_ASIX=y
CONFIG_USB_ETHER_ASIX88179=y
CONFIG_USB_ETHER_MCS7830=y
CONFIG_USB_ETHER_RTL8152=y
CONFIG_USB_ETHER_SMSC95XX=y
CONFIG_USB_GADGET=y
CONFIG_USB_GADGET_MANUFACTURER="Kendryte"
CONFIG_USB_GADGET_VENDOR_NUM=0x29f1
CONFIG_USB_GADGET_PRODUCT_NUM=0x0230
CONFIG_USB_GADGET_DWC2_OTG=y
CONFIG_USB_GADGET_VBUS_DRAW=500
CONFIG_USB_GADGET_DOWNLOAD=y
CONFIG_FAT_WRITE=y
CONFIG_REGEX=y
CONFIG_SPL_GZIP=y
# CONFIG_EFI_LOADER is not set
```

## canmv_k230/src/uboot/uboot/drivers/kburn/Kconfig
```kconfig
menu "Kendryte burning support"

config KBURN
    bool
    imply KBURN_OVER_USB if USB_GADGET

config KBURN_OVER_USB
    bool
	depends on USB_GADGET

if KBURN
config KBURN_MMC
    bool "MMC backend for KBURN"
    select DM_MMC
    help
	  This option enables using KBURN to read and write to MMC based storage.

config KBURN_SF
    bool "sf(SPI Flash) backend for KBURN"
    select DM_SPI_FLASH
	help
	  This option enables using KBURN to read and write to SPI flash based
	  storage.

config KBURN_MTD
	bool "MTD back end for KBURN"
	depends on DM_MTD
	help
	  This option enables using KBURN to read and write to on any MTD device.

endif
endmenu
```

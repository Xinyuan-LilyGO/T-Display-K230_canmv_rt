## canmv_k230/src/rtsmart/rtsmart/kernel/bsp/maix3/drivers/Kconfig
```kconfig
menu "Drivers Configuration"

    menu "InterDriver"
        config RT_USING_ADC
            bool "Using ADC device drivers"
            default n

        menuconfig RT_USING_CIPHER
            bool "Enable CIPHER"
            default n

            if RT_USING_CIPHER
                config RT_USING_AES
                    bool "Use HW AES accelerator"
                    default n
                config RT_USING_HWHASH
                    bool "Use HW SHA256 accelerator"
                    default n
                config RT_USING_SM4
                    bool "Use HW SM4 accelerator"
                    default n
            endif

        config RT_USING_GNNE
            bool "Enable GNNE driver for ai"
            default y

        config RT_USING_GPIO
            bool "Enable GPIO Driver"
            default n

        config RT_USING_HARDLOCK
            bool "Enabel HardLock driver"
            default n
                
        menuconfig RT_USING_HWTIMER
            bool "Using hardware timer device drivers"
            default n
            
            if RT_USING_HWTIMER
                config RT_USING_HW_TIMER0
                    bool "Enable HW Timer0"
                    default n
                config RT_USING_HW_TIMER1
                    bool "Enable HW Timer1"
                    default n
                config RT_USING_HW_TIMER2
                    bool "Enable HW Timer2"
                    default n
                config RT_USING_HW_TIMER3
                    bool "Enable HW Timer3"
                    default n
                config RT_USING_HW_TIMER4
                    bool "Enable HW Timer4"
                    default n
                config RT_USING_HW_TIMER5
                    bool "Enable HW Timer5"
                    default n
            endif

        menuconfig RT_USING_I2C
            bool "Enable I2C"
            default n

            if RT_USING_I2C
                config RT_USING_I2C0
                    bool "Enable I2C0"
                    default n

                    if RT_USING_I2C0
                        config RT_USING_I2C0_SLAVE
                        bool "Enable I2C0 SLAVE mode"
                        default n
                    endif
                config RT_USING_I2C1
                    bool "Enable I2C1"
                    default n

                    if RT_USING_I2C1
                        config RT_USING_I2C1_SLAVE
                        bool "Enable I2C1 SLAVE mode"
                        default n
                    endif
                config RT_USING_I2C2
                    bool "Enable I2C2"
                    default n

                    if RT_USING_I2C2
                        config RT_USING_I2C2_SLAVE
                        bool "Enable I2C2 SLAVE mode"
                        default n
                    endif
                config RT_USING_I2C3
                    bool "Enable I2C3"
                    default n

                    if RT_USING_I2C3
                        config RT_USING_I2C3_SLAVE
                        bool "Enable I2C3 SLAVE mode"
                        default n
                    endif
                config RT_USING_I2C4
                    bool "Enable I2C4"
                    default n

                    if RT_USING_I2C4
                        config RT_USING_I2C4_SLAVE
                        bool "Enable I2C4 SLAVE mode"
                        default n
                    endif
            endif

        menuconfig RT_USING_SPI
            bool "Enable SPI Driver"
            default n

            if RT_USING_SPI
                config RT_USING_SPI0
                    bool "Enable SPI0"
                    default n
                config RT_USING_SPI1
                    bool "Enable SPI1"
                    default n
                config RT_USING_SPI2
                    bool "Enable SPI2"
                    default n
            endif

        config RT_USING_PWM
            bool "Using PWM device drivers"
            default n

        config RT_USING_RTC_PMU
            bool "Using RTC device drivers"
            default n

        menuconfig RT_USING_SDIO
            bool "Enable SDIO Driver"
            default n

            if RT_USING_SDIO
                config RT_USING_SDIO0
                    bool "Enable SDIO0"
                    default n

                if RT_USING_SDIO0
                    config RT_SDIO0_EMMC
                        bool "SDIO0 device is eMMC"
                        default n
                    config RT_SDIO0_1V8
                        bool "SDIO0 device is 1.8V"
                        default n
                endif

                config RT_USING_SDIO1
                    bool "Enable SDIO1"
                    default n

                choice SDCARD_ON_SDIO_DEV
                    bool "SdCard is on SDIOx"

                    config SDCARD_ON_SDIO_DEV0
                        bool "SdCard is on SDIO0"

                    config SDCARD_ON_SDIO_DEV1
                        bool "SdCard is on SDIO1"
                endchoice

                config SDCARD_ON_SDIO_DEV
                    int 
                    default 0 if SDCARD_ON_SDIO_DEV0
                    default 1 if SDCARD_ON_SDIO_DEV1
            endif

            config RT_USING_SPI
                bool "Enable SPI1 device driver"
                default n
            
            config RT_USING_TS
                bool "Enable Tsensor device driver"
                default n
            
            menuconfig RT_USING_CANAAN_UART
                bool "Enable Uart Canaan device model driver"
                default n
                
                if RT_USING_CANAAN_UART
                    config RT_USING_UART_CANAAN_1
                        bool "Enable Uart Canaan device 1"
                        default n
                    config RT_USING_UART_CANAAN_2
                        bool "Enable Uart Canaan device 2"
                        default n
                    config RT_USING_UART_CANAAN_3
                        bool "Enable Uart Canaan device 3"
                        default n
                    config RT_USING_UART_CANAAN_4
                        bool "Enable Uart Canaan device 4"
                        default n

                    config CANAAN_UART_BUFFER_SIZE
                        int "Uart Canaan Buffer size in Bytes"
                        default 131072

                    config POLLIN_SIZE
                        int
                        default CANAAN_UART_BUFFER_SIZE/2

                    config UART_TIMEOUT
                        int "Uart Canaan Pool timeout"
                        default 1000
                endif

            config RT_USING_WDT
                bool "Using Watch Dog device drivers"
                default n
    endmenu

    menu "Ext Driver"
        menuconfig RT_USING_CYW43XX
            bool "Enable CYW43XX WiFi Driver"
            default n

            if RT_USING_CYW43XX
                choice CYW43XX_SDIO_DEV
                    bool "CYW43XX Wifi Use SDIO Device"

                    config CYW43XX_SDIO_DEV0
                        bool "Using SDIO0"
                    config CYW43XX_SDIO_DEV1
                        bool "Using SDIO1"
                endchoice

                config CYW43XX_SDIO_DEV
                    int
                    default 0 if CYW43XX_SDIO_DEV0
                    default 1 if CYW43XX_SDIO_DEV1

                config CYW43XX_THREAD_PRIORITY
                    int
                    default 10
                config CYW43XX_THREAD_STACK_SIZE
                    int
                    default 4096
            endif

        menuconfig RT_USING_EEPROM
            bool "Enable EEPROM over GPIO Driver"
            default n

            if RT_USING_EEPROM


            endif
        menuconfig RT_USING_LORA
            bool "Enable LORA over GPIO Driver"
            default n

            if RT_USING_LORA


            endif        
        menuconfig RT_USING_REALTEK
            bool "Enable Realtek WiFi Driver"
            default n

            if RT_USING_REALTEK
                choice REALTEK_SDIO_DEV
                    bool "Realtek Wifi Use SDIO Device"

                    config REALTEK_SDIO_DEV0
                        bool "Using SDIO0"
                    config REALTEK_SDIO_DEV1
                        bool "Using SDIO1"
                endchoice

                config REALTEK_SDIO_DEV
                    int
                    default 0 if REALTEK_SDIO_DEV0
                    default 1 if REALTEK_SDIO_DEV1
            endif

        menuconfig RT_USING_REGULATOR
            bool "Enable regulator Driver"
            depends on RT_USING_PM
            default y

            if RT_USING_REGULATOR
                config RT_USING_REGULATOR_TPS6286X
                    bool "Use TPS6286X"
                    default n
            endif

        if RT_USING_TOUCH
            menuconfig RT_USING_TOUCH_FT5316
                bool "Enable Touch FT5316"
                default n

                if RT_USING_TOUCH_FT5316
                    config TOUCH_FT5316_I2C_DEV
                        string "I2C Device name"
                        default "i2c3"

                    config TOUCH_FT5316_I2C_ADDR
                        hex
                        default 0x38
                endif
            menuconfig RT_USING_TOUCH_GT9895
                bool "Enable Touch GT9895"
                default n

                if RT_USING_TOUCH_GT9895
                    config TOUCH_GT9895_I2C_DEV
                        string "I2C Device name"
                        default "i2c3"

                    config TOUCH_GT9895_I2C_ADDR
                        hex
                        default 0x5d
                endif
        endif

        menuconfig RT_USING_WS2812
            bool "Enable WS2812"
            default n

            if RT_USING_WS2812
                choice WS2812_USE_DRV
                    bool "WS2812 Use Drive mode"
                    default WS2812_USE_DRV_GPIO

                    config WS2812_USE_DRV_GPIO
                        bool "Using GPIO"
                    config WS2812_USE_DRV_I2S
                        bool "Using I2S"
                endchoice

                if WS2812_USE_DRV_GPIO
                    config WS2812_GPIO_PIN_NUM
                        int "WS2812 GPIO Output Pin"
                        default 35
                endif
            endif
    endmenu
endmenu
```

## canmv_k230/src/uboot/uboot/arch/riscv/cpu/k230/Kconfig
```kconfig
#
# Copyright (C) 2017-2020 Alibaba Group Holding Limited
#
# SPDX-License-Identifier: GPL-2.0+
#

config KENDRYTE_K230
	bool
	select ARCH_EARLY_INIT_R
	select SUPPORT_SPL
	imply CPU
	imply CPU_RISCV
	imply RISCV_TIMER
	imply RISCV_RDTIME
	imply CMD_CPU
	imply SPL_CPU
	imply SPL_OPENSBI
	imply SPL_LOAD_FIT
```

## canmv_k230/src/uboot/uboot/board/kendryte/k230_burntool/Kconfig
```kconfig
if TARGET_K230_BURNTOOL

    config SYS_CPU
        default "k230"

    config SYS_VENDOR
        default "kendryte"

    config SYS_BOARD
        default "k230_burntool"

    config SYS_CONFIG_NAME
        default "k230_common"

    config BOARD_SPECIFIC_OPTIONS
        def_bool y
        select KENDRYTE_K230

endif
```

## canmv_k230/src/uboot/uboot/board/kendryte/k230_canmv/Kconfig
```kconfig
if TARGET_K230_CANMV

    config SYS_CPU
        default "k230"

    config SYS_VENDOR
        default "kendryte"

    config SYS_BOARD
        default "k230_canmv"

    config SYS_CONFIG_NAME
        default "k230_common"

    config BOARD_SPECIFIC_OPTIONS
        def_bool y
        select KENDRYTE_K230

    choice
        prompt "DDR Type And Frequency"
        default CANMV_LPDDR3_2133

        config CANMV_LPDDR3_2133
            bool "k230 canmv ddr3 2133"    
    endchoice
endif
```

## canmv_k230/src/uboot/uboot/board/kendryte/k230_canmv_01studio/Kconfig
```kconfig
if TARGET_K230_CANMV_01STUDIO

	config SYS_CPU
		default "k230"

	config SYS_VENDOR
		default "kendryte"

	config SYS_BOARD
		default "k230_canmv_01studio"

	config SYS_CONFIG_NAME
		default "k230_common"

	config BOARD_SPECIFIC_OPTIONS
		def_bool y
		select KENDRYTE_K230

	choice
		prompt "DDR Type And Frequency"
		default CANMV_01STUDIO_LPDDR4_2667

		config CANMV_01STUDIO_LPDDR3_2133
			bool "LPDDR3@2133"
		config CANMV_01STUDIO_LPDDR3_1600
			bool "LPDDR3@1600"
		config CANMV_01STUDIO_LPDDR3_800
			bool "LPDDR3@800"
		config CANMV_01STUDIO_LPDDR4_2667
			bool "LPDDR4@2667"
		config CANMV_01STUDIO_LPDDR4_3200
			bool "LPDDR4@3200"
	endchoice

endif
```

## canmv_k230/src/uboot/uboot/board/kendryte/k230_canmv_dongshanpi/Kconfig
```kconfig
if TARGET_K230_CANMV_DONGSHANPI

config SYS_CPU
	default "k230"

config SYS_VENDOR
	default "kendryte"

config SYS_BOARD
	default "k230_canmv_dongshanpi"

config SYS_CONFIG_NAME
	default "k230_common"

config BOARD_SPECIFIC_OPTIONS
	def_bool y
	select KENDRYTE_K230

    choice
        prompt "DDR Type And Frequency"
        default CANMV_DONGSHANPI_LPDDR3_1866

        config CANMV_DONGSHANPI_LPDDR3_2133
            bool "k230 canmv dongshanpi ddr3 2133"
        config CANMV_DONGSHANPI_LPDDR3_1866
            bool "k230 canmv dongshanpi ddr3 1866"
    endchoice
endif
```

## canmv_k230/src/uboot/uboot/board/kendryte/k230_canmv_v3p0/Kconfig
```kconfig
if TARGET_K230_CANMV_V3P0

	config SYS_CPU
		default "k230"

	config SYS_VENDOR
		default "kendryte"

	config SYS_BOARD
		default "k230_canmv_v3p0"

	config SYS_CONFIG_NAME
		default "k230_common"

	config BOARD_SPECIFIC_OPTIONS
		def_bool y
		select KENDRYTE_K230

	choice
		prompt "DDR Type And Frequency"
		default CANMV_V3P0_LPDDR4_2667

		config CANMV_V3P0_LPDDR4_2667
			bool "LPDDR4@2667"
	endchoice

endif
```

## canmv_k230/src/uboot/uboot/board/kendryte/k230d_canmv_bpi_zero/Kconfig
```kconfig
if TARGET_K230D_CANMV_BPI_ZERO

    config SYS_CPU
        default "k230"

    config SYS_VENDOR
        default "kendryte"

    config SYS_BOARD
        default "k230d_canmv_bpi_zero"

    config SYS_CONFIG_NAME
        default "k230_common"

    config BOARD_SPECIFIC_OPTIONS
        def_bool y
        select KENDRYTE_K230

	choice
		prompt "DDR Type And Frequency"
		default K230D_SIP_LPDDR4_2667

		config K230D_SIP_LPDDR4_1600
			bool "SiP LPDDR4@1600"
		config K230D_SIP_LPDDR4_2667
			bool "SiP LPDDR4@2667"
		config K230D_SIP_LPDDR4_3200_ALLODT
			bool "SiP LPDDR4@3200 allodt"
		config K230D_SIP_LPDDR4_3200_HWODT
			bool "SiP LPDDR4@3200 hwodt"
	endchoice

endif
```
